## components/vault_core/Kconfig.projbuild
```kconfig
menu "AnkiReader"

config ANKIREADER_TIMEZONE
    string "Local timezone (POSIX TZ)"
    default "KST-9"
    help
      POSIX TZ string for device-local timekeeping and companion metadata.
      There is no RTC on the EE04, so local time comes entirely from SNTP.
      Examples: "KST-9" (Korea), "JST-9" (Japan), "EST5EDT,M3.2.0,M11.1.0"
      (US Eastern), "CET-1CEST,M3.5.0,M10.5.0/3" (Central Europe), "UTC0".

config ANKIREADER_POLL_SECONDS
    int "Study poll interval (seconds)"
    default 300
    range 30 86400
    help
      How often the device fetches the current study card. Polling costs nothing
      visible — the panel is only refreshed when the fetched content actually
      differs from what is on the glass — so the floor here is about not
      hammering somebody's laptop, not about e-Paper wear.

      A snapshot older than twice this interval is reported stale through the
      companion API; operational status is not printed on the card.

endmenu
```
